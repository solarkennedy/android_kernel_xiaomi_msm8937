/* FT8613 720x1280 video mode panel - hardware variant v2 (20180614)
 *
 * This is the panel variant the Palm PVG100 bootloader selects via:
 *   mdss_mdp.panel=...qcom,mdss_dsi_ft8613_720p_video_1280p...
 *
 * The v1 (20171211) node was wrong: different init sequence, different DSI
 * timing parameters, and incorrect SET_PAGE_ADDRESS (1439 instead of 1279).
 * This node is derived from the stock AML0 firmware DTS.
 */

&mdss_mdp {
	dsi_ft8613_720p_vid_v2: qcom,mdss_dsi_ft8613_720p_video_1280p {
		qcom,mdss-dsi-panel-name =
			"ft8613 1280p video mode dsi panel[20180614_v2]";
		qcom,mdss-dsi-panel-type = "dsi_video_mode";
		qcom,mdss-dsi-panel-framerate = <60>;
		qcom,mdss-dsi-virtual-channel-id = <0>;
		qcom,mdss-dsi-stream = <0>;
		qcom,mdss-dsi-panel-width = <720>;
		qcom,mdss-dsi-panel-height = <1280>;
		qcom,mdss-pan-physical-width-dimension = <41>;
		qcom,mdss-pan-physical-height-dimension = <73>;
		qcom,mdss-dsi-h-front-porch = <108>;
		qcom,mdss-dsi-h-back-porch = <108>;
		qcom,mdss-dsi-h-pulse-width = <4>;
		qcom,mdss-dsi-h-sync-skew = <0>;
		qcom,mdss-dsi-v-back-porch = <16>;
		qcom,mdss-dsi-v-front-porch = <16>;
		qcom,mdss-dsi-v-pulse-width = <2>;
		qcom,mdss-dsi-h-left-border = <0>;
		qcom,mdss-dsi-h-right-border = <0>;
		qcom,mdss-dsi-v-top-border = <0>;
		qcom,mdss-dsi-v-bottom-border = <0>;
		qcom,mdss-dsi-bpp = <24>;
		qcom,mdss-dsi-underflow-color = <0xff>;
		qcom,mdss-dsi-border-color = <0>;
		qcom,mdss-dsi-on-command = [
			15 01 00 00 00 00 02 00 00
			39 01 00 00 00 00 04 ff 87 16 01
			15 01 00 00 00 00 02 00 80
			39 01 00 00 00 00 03 ff 87 16
			15 01 00 00 00 00 02 00 80
			39 01 00 00 00 00 10 c0 00 b4 00 10 10 00 b4
				10 10 00 b4 00 10 10 00
			15 01 00 00 00 00 02 00 a0
			39 01 00 00 00 00 08 c0 00 02 02 10 01 25 0a
			15 01 00 00 00 00 02 00 d0
			39 01 00 00 00 00 08 c0 00 02 02 10 01 25 0a
			15 01 00 00 00 00 02 00 82
			39 01 00 00 00 00 0a a5 33 02 0c 00 00 00 07
				77 77
			15 01 00 00 00 00 02 00 80
			39 01 00 00 00 00 05 c2 84 02 5a e5
			15 01 00 00 00 00 02 00 e0
			39 01 00 00 00 00 05 c2 02 01 0a 0a
			15 01 00 00 00 00 02 00 f4
			39 01 00 00 00 00 06 c2 85 05 06 30 00
			15 01 00 00 00 00 02 00 b0
			39 01 00 00 00 00 10 c2 84 01 00 0b 81 83 02
				00 0b 81 82 03 00 0b 81
			15 01 00 00 00 00 02 00 c0
			39 01 00 00 00 00 06 c2 81 04 00 0b 81
			15 01 00 00 00 00 02 00 da
			39 01 00 00 00 00 03 c2 33 33
			15 01 00 00 00 00 02 00 aa
			39 01 00 00 00 00 03 c3 39 9c
			15 01 00 00 00 00 02 00 d0
			39 01 00 00 00 00 0e c3 00 0a 0a 00 00 00 00
				01 04 00 5a 00 00
			15 01 00 00 00 00 02 00 e0
			39 01 00 00 00 00 0e c3 00 0a 0a 00 00 00 00
				01 04 00 5a 00 00
			15 01 00 00 00 00 02 00 80
			39 01 00 00 00 00 07 ce 25 00 68 00 78 ff
			15 01 00 00 00 00 02 00 89
			15 01 00 00 00 00 02 ce c8
			15 01 00 00 00 00 02 00 90
			39 01 00 00 00 00 09 ce 00 5c 0d 9b 00 5c 00
				06
			15 01 00 00 00 00 02 00 a1
			39 01 00 00 00 00 08 ce 00 06 00 00 01 01 01
			15 01 00 00 00 00 02 00 80
			39 01 00 00 00 00 0d cc 02 24 10 01 06 07 08
				09 20 21 24 24
			15 01 00 00 00 00 02 00 90
			39 01 00 00 00 00 0d cc 10 24 02 01 09 08 07
				06 20 21 24 24
			15 01 00 00 00 00 02 00 a0
			39 01 00 00 00 00 10 cc 1a 1b 1c 1d 1e 1f 18
				19 14 15 24 24 24 24 24
			15 01 00 00 00 00 02 00 b0
			39 01 00 00 00 00 06 cc 24 24 24 24 24
			15 01 00 00 00 00 02 00 80
			39 01 00 00 00 00 09 cb 00 00 00 c0 30 0c 03
				00
			15 01 00 00 00 00 02 00 90
			39 01 00 00 00 00 10 cb 00 00 00 c0 00 00 00
				00 00 ff 00 00 00 00 00
			15 01 00 00 00 00 02 00 a0
			39 01 00 00 00 00 10 cb 00 00 00 00 00 00 00
				00 00 00 00 00 00 00 00
			15 01 00 00 00 00 02 00 b0
			39 01 00 00 00 00 03 cb 00 00
			15 01 00 00 00 00 02 00 c0
			39 01 00 00 00 00 10 cb 15 00 15 2a 15 15 15
				15 2a d5 00 00 15 15 15
			15 01 00 00 00 00 02 00 d0
			39 01 00 00 00 00 10 cb 15 15 15 55 55 00 00
				00 00 00 00 00 00 00 00
			15 01 00 00 00 00 02 00 e0
			39 01 00 00 00 00 03 cb 00 00
			15 01 00 00 00 00 02 00 f0
			39 01 00 00 00 00 09 cb f3 ff 0f 3f f0 0c 00
				00
			15 01 00 00 00 00 02 00 80
			39 01 00 00 00 00 10 cd 01 03 13 14 04 16 16
				06 08 09 15 0a 0d 0d 0e
			15 01 00 00 00 00 02 00 90
			39 01 00 00 00 00 04 cd 0e 0f 0f
			15 01 00 00 00 00 02 00 a0
			39 01 00 00 00 00 10 cd 01 03 13 14 04 16 16
				05 07 09 22 0a 0d 0d 0e
			15 01 00 00 00 00 02 00 b0
			39 01 00 00 00 00 04 cd 0e 0f 0f
			15 01 00 00 00 00 02 00 81
			39 01 00 00 00 00 0d f3 ff f3 c0 ff f3 c0 00
				02 00 00 02 00
			15 01 00 00 00 00 02 00 86
			15 01 00 00 00 00 02 b0 0b
			15 01 00 00 00 00 02 00 c0
			15 01 00 00 00 00 02 c0 01
			15 01 00 00 00 00 02 00 8c
			39 01 00 00 00 00 03 f5 15 21
			15 01 00 00 00 00 02 00 a0
			39 01 00 00 00 00 08 b3 03 02 d0 05 00 00 50
			15 01 00 00 00 00 02 00 00
			39 01 00 00 00 00 05 2a 00 00 02 cf
			15 01 00 00 00 00 02 00 00
			39 01 00 00 00 00 05 2b 00 00 04 ff
			15 01 00 00 00 00 02 00 90
			39 01 00 00 00 00 08 b0 09 09 05 08 08 04 29
			15 01 00 00 00 00 02 00 80
			39 01 00 00 00 00 0b c5 00 c1 dd c4 14 1e 00
				55 50 04
			15 01 00 00 00 00 02 00 90
			39 01 00 00 00 00 0b c5 77 19 1e 00 88 01 28
				50 55 50
			15 01 00 00 00 00 02 00 88
			39 01 00 00 00 00 03 c3 22 22
			15 01 00 00 00 00 02 00 98
			39 01 00 00 00 00 03 c3 22 22
			15 01 00 00 00 00 02 00 90
			39 01 00 00 00 00 05 cf ff 00 fe 00
			15 01 00 00 00 00 02 00 94
			39 01 00 00 00 00 05 cf 00 00 10 20
			15 01 00 00 00 00 02 00 a4
			39 01 00 00 00 00 05 cf 00 07 01 80
			15 01 00 00 00 00 02 00 d0
			15 01 00 00 00 00 02 cf 08
			15 01 00 00 00 00 02 00 00
			39 01 00 00 00 00 03 d8 21 21
			15 01 00 00 00 00 02 00 00
			39 01 00 00 00 00 19 e1 07 10 24 37 41 4d 5d
				69 6e 75 7b 81 79 74 72 6c 5d 51 41 37
				2e 1f 11 12
			15 01 00 00 00 00 02 00 00
			39 01 00 00 00 00 19 e2 01 10 24 37 41 4d 5d
				69 6e 75 7b 81 79 74 72 6c 5d 51 41 37
				2e 1f 11 08
			15 01 00 00 00 00 02 00 01
			15 01 00 00 00 00 02 c6 10
			15 01 00 00 00 00 02 00 00
			39 01 00 00 00 00 13 c8 90 78 56 34 33 33 33
				33 33 33 43 44 43 44 44 44 44 54
			15 01 00 00 00 00 02 00 01
			15 01 00 00 00 00 02 c6 11
			15 01 00 00 00 00 02 00 00
			39 01 00 00 00 00 13 c8 90 78 56 34 33 33 22
				33 33 43 44 44 43 44 44 44 44 54
			15 01 00 00 00 00 02 00 01
			15 01 00 00 00 00 02 c6 12
			15 01 00 00 00 00 02 00 00
			39 01 00 00 00 00 13 c8 e0 8c 56 33 33 33 33
				33 33 33 23 22 33 43 44 44 44 44
			15 01 00 00 00 00 02 00 01
			15 01 00 00 00 00 02 c6 00
			15 01 00 00 00 00 02 00 00
			15 01 00 00 00 00 02 92 00
			15 01 00 00 00 00 02 00 90
			15 01 00 00 00 00 02 b3 01
			15 01 00 00 00 00 02 00 92
			15 01 00 00 00 00 02 b3 40
			15 01 00 00 00 00 02 00 98
			15 01 00 00 00 00 02 b0 0c
			05 01 00 00 78 00 02 11 00
			05 01 00 00 14 00 02 29 00];
		qcom,mdss-dsi-off-command = [
			05 01 00 00 14 00 02 28 00
			05 01 00 00 78 00 02 10 00];
		qcom,mdss-dsi-on-command-state = "dsi_lp_mode";
		qcom,mdss-dsi-off-command-state = "dsi_hs_mode";
		qcom,mdss-dsi-h-sync-pulse = <1>;
		qcom,mdss-dsi-traffic-mode = "burst_mode";
		qcom,mdss-dsi-bllp-eof-power-mode;
		qcom,mdss-dsi-bllp-power-mode;
		qcom,mdss-dsi-lane-0-state;
		qcom,mdss-dsi-lane-1-state;
		qcom,mdss-dsi-lane-2-state;
		qcom,mdss-dsi-lane-3-state;
		qcom,mdss-dsi-panel-timings = [7f 1c 12 00 40 44 16 1e 17 03 04 00];
		qcom,mdss-dsi-t-clk-post = <0x04>;
		qcom,mdss-dsi-t-clk-pre = <0x1b>;
		qcom,mdss-dsi-bl-min-level = <1>;
		qcom,mdss-dsi-bl-max-level = <4095>;
		qcom,mdss-dsi-dma-trigger = "trigger_sw";
		qcom,mdss-dsi-mdp-trigger = "none";
		qcom,mdss-dsi-bl-pmic-control-type = "bl_ctrl_wled";
		qcom,mdss-dsi-reset-sequence = <1 20 0 6 1 120>;
	};
};
