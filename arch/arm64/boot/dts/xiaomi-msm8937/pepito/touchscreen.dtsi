/*
 * Pepito touch controller — FocalTech FT8613 (in-cell IDC) at I2C BLSP1
 * QUP3 (i2c_3), address 0x38.
 *
 * Chip: FT8613 (_FT8613 = 0x8613080C), confirmed via register reads
 * (0xA3=0x86, 0x9F=0x13).  It is an in-cell (IDC) controller integrated
 * with the display panel.
 *
 * Driver: techpack/xiaomi-msm8937/touchscreen/focaltech_touch/
 * (CONFIG_TOUCHSCREEN_FTS_MI8937), compatible "focaltech,fts_ts-mi8937".
 * focaltech,ic-type tells the driver this is an IDC chip so it uses the
 * correct one-byte boot ID read format and skips HID mode.
 * focaltech,ignore-id-check bypasses the FTS_CHIP_TYPE_MAPPING table
 * lookup and accepts whatever chip ID registers 0xA3/0x9F return.
 */
&i2c_3 {
	status = "okay";

	focaltech_ts@38 {
		compatible = "focaltech,fts_ts-mi8937";
		reg = <0x38>;
		interrupt-parent = <&tlmm>;
		interrupts = <65 0x2>;
		vdd-supply = <&pm8937_l10>;
		vcc_i2c-supply = <&pm8937_l6>;
		pinctrl-names = "pmx_ts_active", "pmx_ts_suspend", "pmx_ts_release";
		pinctrl-0 = <&ts_int_active &ts_reset_active>;
		pinctrl-1 = <&ts_int_suspend &ts_reset_suspend>;
		pinctrl-2 = <&ts_release>;
		focaltech,reset-gpio = <&tlmm 64 0x0>;
		focaltech,irq-gpio = <&tlmm 65 0x2>;
		focaltech,max-touch-number = <5>;
		focaltech,display-coords = <0 0 720 1280>;
		focaltech,ic-type = <0x8613080C>;
		focaltech,ignore-id-check;
	};
};
