## drivers/misc/bhy/Kconfig
```kconfig
#
# Makefile for Bosch sensors driver.
#
config SENSORS_BHY
	tristate "BHY sensor hub driver support"
	default n
	depends on I2C
	help
	  If you say yes here, you get support for Bosch Sensortec's
	  BHY sensor hub driver.
```
